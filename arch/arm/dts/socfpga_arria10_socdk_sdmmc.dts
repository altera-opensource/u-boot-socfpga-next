/*
 * Copyright (C) 2016-2017 Intel Corporation
 *
 * SPDX-License-Identifier:	GPL-2.0        X11
 */

/dts-v1/;
#include "socfpga_arria10_socdk_sdmmc_handoff.dtsi"

/ {
	chosen {
		bootargs = "console=ttyS0,115200";
	};
};

&uart1 {
	u-boot,dm-pre-reloc;
	status = "okay";
};

&mmc {
	u-boot,dm-pre-reloc;
	status = "okay";
	num-slots = <1>;
	cap-sd-highspeed;
	broken-cd;
	bus-width = <4>;
	altr,dw-mshc-ciu-div = <3>;
	altr,dw-mshc-sdr-timing = <0 3>;
};
